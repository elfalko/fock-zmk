// fock_left.overlay

#include "fock.dtsi" 

&kscan0 {
    col-gpios =
        <&pro_micro 9 (GPIO_ACTIVE_HIGH | GPIO_PULL_DOWN)>, // outer num
        <&pro_micro 8 (GPIO_ACTIVE_HIGH | GPIO_PULL_DOWN)>, // pinky top
        <&pro_micro 7 (GPIO_ACTIVE_HIGH | GPIO_PULL_DOWN)>, // ring home
        <&pro_micro 6 (GPIO_ACTIVE_HIGH | GPIO_PULL_DOWN)>, // middle bottom
        <&pro_micro 5 (GPIO_ACTIVE_HIGH | GPIO_PULL_DOWN)>, // index bottom
        <&pro_micro 4 (GPIO_ACTIVE_HIGH | GPIO_PULL_DOWN)>, // inner bottom
        <&pro_micro 10 (GPIO_ACTIVE_HIGH | GPIO_PULL_DOWN)> // thumb bottom
        ;
};
